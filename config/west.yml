## config/west.yml
```yaml
# Copyright (c) 2025 The ZMK Contributors
# SPDX-License-Identifier: LicenseRef-Nordic-5-Clause

manifest:
  remotes:
    - name: zmkfirmware
      url-base: https://github.com/zmkfirmware
  projects:
    - name: zmk
      remote: zmkfirmware
      revision: main
      import: app/west.yml
  self:
    path: config
```

## dts/bindings/zmk,behavior-caps-word-custom.yaml
```yaml
# Copyright (c) 2025 The ZMK Contributors
# SPDX-License-Identifier: MIT

description: |
  Complete specification of ESB split connection

compatible: "zmk,behavior-caps-word-custom"

include: zero_param.yaml

properties:
  continue-list:
    type: array
    required: true
  mods:
    type: int
```

## src/behaviors/Kconfig
```kconfig
# Copyright (c) 2025 The ZMK Contributors
# SPDX-License-Identifier: LicenseRef-Nordic-5-Clause

config ZMK_BEHAVIOR_CAPS_WORD_CUSTOM
    bool "Custom Caps Word Behavior"
    default n
    help
      Enable custom caps word behavior (central only for split keyboards)
    depends on ZMK_SPLIT_ROLE_CENTRAL || !ZMK_SPLIT
```
